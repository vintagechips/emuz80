;	HELLO - EMUZ80 HELLO, WORLD AND ECHO BACK
;	TARGET: EMUZ80
;	ASSEMBLER: ARCPIT XZ80.EXE
;
UARTDR	EQU	0E000H	; UART DATA REGISTOR
UARTCR	EQU	0E001H	; UART CONTROL REGISTOR
ROMTOP	EQU	0000H	; ROM TOP
RAMTOP	EQU	8000H	; RAM TOP
RAMSIZ	EQU	1000H	; RAM SIZE
STACK	EQU	(RAMTOP+RAMSIZ)
;
;	RESET
	ORG	ROMTOP
;
;	START
	LD	SP,STACK
	LD	HL,MESSAGE
HLLOOP:	LD	A,(HL)
	CP	00H
	JR	Z,EBLOOP
	CALL	PUTCH
	INC	HL
	JR	HLLOOP
;
EBLOOP:	CALL	GETCH
	CALL	PUTCH
	JR	EBLOOP
;
PUTCH:	PUSH	AF
PCST1:	LD	A,(UARTCR)
	BIT	1,A
	JR	Z,PCST1
	POP	AF
	LD	(UARTDR),A
	RET
;
GETCH:	LD	A,(UARTCR)
	BIT	0,A
	JR	Z,GETCH
	LD	A,(UARTDR)
	RET
;
MESSAGE	DB	'HELLO, WORLD',0DH,0AH,0
;
	END	0000H
